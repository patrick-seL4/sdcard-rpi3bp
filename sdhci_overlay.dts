
// Modify the Pin Controller for the SDHCI controller so that we can use the
// SDHCI controller to interact with the device's SD card.
/dts-v1/;
/plugin/;

/ {
	compatible = "raspberrypi,3-model-b-plus", "brcm,bcm2837";
	model = "Raspberry Pi 3 Model B+";

    fragment@0 {
        target = <&sdhci>;
        __overlay__ {
            #address-cells = <1>;
            #size-cells = <0>;
            pinctrl-names = "default";
            pinctrl-0 = <&sdhost_gpio48>; // This is the only line that has been modified. It originally had the value of <&emmc_gpio34>.
            status = "okay";
            bus-width = <4>;
            non-removable;
            mmc-pwrseq = <&wifi_pwrseq>;

            brcmf: wifi@1 {
                reg = <1>;
                compatible = "brcm,bcm4329-fmac";
            };
        };
    };
};